## boards/shields/toucan/Kconfig.defconfig
```kconfig
if SHIELD_TOUCAN_LEFT

config ZMK_KEYBOARD_NAME
    default "Toucan"

config ZMK_SPLIT_ROLE_CENTRAL
    default y

config ZMK_SPLIT_BLE_CENTRAL_BATTERY_LEVEL_FETCHING
    default y

config ZMK_SPLIT_BLE_CENTRAL_BATTERY_LEVEL_PROXY
    default y

endif



if SHIELD_TOUCAN_LEFT || SHIELD_TOUCAN_RIGHT

config SPI
    default y

config ZMK_SPLIT
    default y

config ZMK_POINTING
    default y

config RGBLED_WIDGET_BATTERY_LEVEL_HIGH
    default 40

config TOUCAN_DEBUG_INSTRUMENTATION
    bool "Toucan: log activity-state, input-rate, conn-params, stack HWM"
    default n
    select THREAD_MONITOR
    select THREAD_NAME
    select THREAD_STACK_INFO
    select INIT_STACKS
    help
      Emits diagnostic lines on the toucan_dbg log module so we can correlate
      ZMK activity-state transitions, input-event rate, BLE LE parameter
      updates, and per-thread stack high-water-marks against future trackpad
      or split-link bugs. Runs a 1024-byte monitor thread independent of the
      system workqueue so it survives a sysworkq deadlock. Daily-driver
      builds should leave this n. To capture diagnostics over USB CDC ACM,
      uncomment the matching block in config/toucan.conf which enables
      ZMK_USB_LOGGING alongside this flag.

endif
```

## boards/shields/toucan/Kconfig.shield
```kconfig
config SHIELD_TOUCAN_LEFT
    def_bool $(shields_list_contains,toucan_left)

config SHIELD_TOUCAN_RIGHT
    def_bool $(shields_list_contains,toucan_right)
```

## config/west.yml
```yaml
manifest:
  remotes:
    - name: zmkfirmware
      url-base: https://github.com/zmkfirmware
    - name: caksoylar
      url-base: https://github.com/caksoylar
    - name: geeksville
      url-base: https://github.com/geeksville
    - name: kalbasit
      url-base: https://github.com/kalbasit
  projects:
    - name: zmk
      remote: zmkfirmware
      revision: 3cf9006a9377f21c99e944e29e2a507d8c3e9069  # v0.3
      import: app/west.yml
    - name: zephyr
      remote: zmkfirmware
      revision: dacab4875df72109b96cc8977547a0dc04875bcd  # v3.5.0+zmk-fixes
      import:
        name-blocklist:
          - ci-tools
          - hal_altera
          - hal_cypress
          - hal_infineon
          - hal_microchip
          - hal_nxp
          - hal_openisa
          - hal_silabs
          - hal_xtensa
          - hal_st
          - hal_ti
          - loramac-node
          - mcuboot
          - mcumgr
          - net-tools
          - openthread
          - edtt
          - trusted-firmware-m
    # Cirque trackpad input module — kalbasit fork carrying toucan stability
    # fixes on top of geeksville's toucan branch (branch: toucan-fixes):
    #   - re-arm DR IRQ on every early-return path (trackpad-wedge fix)
    #   - report input with K_NO_WAIT so a full input queue can never block the
    #     system workqueue (right-half lock-up fix, kalbasit/zmk-config#215)
    - name: cirque-input-module
      remote: kalbasit
      revision: c3e1fcfd8f9fba2e1f8f09ed664822870bce61ca
    # RGB LED widget
    - name: zmk-rgbled-widget
      remote: caksoylar
      revision: v0.3
  self:
    path: config
```
